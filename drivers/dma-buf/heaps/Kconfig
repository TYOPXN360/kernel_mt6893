## drivers/dma-buf/heaps/Kconfig
```kconfig
config DMABUF_HEAPS_DEFERRED_FREE
	tristate

config DMABUF_HEAPS_PAGE_POOL
	tristate

config DMABUF_HEAPS_SYSTEM
	tristate "DMA-BUF System Heap"
	depends on DMABUF_HEAPS
	select DMABUF_HEAPS_PAGE_POOL
	select DMABUF_HEAPS_DEFERRED_FREE
	help
	  Choose this option to enable the system dmabuf heap. The system heap
	  is backed by pages from the buddy allocator. If in doubt, say Y.

config DMABUF_HEAPS_CMA
	tristate "DMA-BUF CMA Heap"
	depends on DMABUF_HEAPS && DMA_CMA
	help
	  Choose this option to enable dma-buf CMA heap. This heap is backed
	  by the Contiguous Memory Allocator (CMA). If your system has these
	  regions, you should say Y here.

config DMABUF_HEAPS_MTK_MM
	bool "DMA-BUF MediaTek mtk_mm Heap"
	depends on DMABUF_HEAPS && ION
	help
	  Register the "mtk_mm" and "mtk_mm-uncached" heaps that the
	  MediaTek userspace gralloc asks for.  The buffers are allocated
	  through ION and exported with ION's dma_buf_ops so that the
	  MediaTek composer, which can only import ION buffers, accepts
	  them instead of leaking a file descriptor per rejected layer.
```

## drivers/misc/chopin-crumb/Kconfig
```kconfig
config CHOPIN_CRUMB
	bool "Chopin early-boot breadcrumbs"
	help
	  Record early boot progress into the pstore block at 0x48090000 so
	  it is carried into the expdb partition on the next start. Used to
	  locate where the 4.19 kernel stops, since UART output is muted by
	  LK and no in-kernel dump path exists on this tree.

	  Each stage stores a small record through the identity map (before
	  setup_arch()) or the linear map (after it) and cleans it to the
	  point of coherency, so the value survives into DRAM where LK's
	  kedump exports it.

	  Say N if you do not need boot breadcrumbs on Chopin.
```

## drivers/misc/mediatek/boot/Kconfig
```kconfig
config MTK_BOOT
	bool "Enable MTK Boot information Driver"
	default y
	help
	  Boot information driver includes specific information about booting
	  process, such as boot mode. It provides the boot mode and boot type
	  to other drivers, and exposes /sys/class/BOOT/BOOT/boot/ so that
	  userspace -- notably tee-supplicant, which reads boot_type to decide
	  between the eMMC and UFS RPMB paths -- can read them.
```

## drivers/rekernel_x/Kconfig
```kconfig
# SPDX-License-Identifier: GPL-2.0
config REKERNELX
	bool "ReKernel-X"
	depends on KSU
	help
	  ReKernel-X surfaces kernel-side events for frozen (cached) processes so
	  tombstone-style modules can react to them:
	    - Binder: a frozen process receiving a Binder call
	    - Signal: a frozen process receiving SIGKILL and friends
	    - Network: a monitored UID receiving an inbound packet

	  Events are delivered to userspace over Generic Netlink. The hooks are
	  resolved at runtime through kprobes, so the module does not need
	  compile-time access to the binder internals and builds against both
	  4.14 and 5.10+ trees.

	  Say N if unsure.
```

## drivers/tee/mitee/Kconfig
```kconfig
# OP-TEE Trusted Execution Environment Configuration
config MITEE
	tristate "OP-TEE"
	help
	  This implements the OP-TEE Trusted Execution Environment (TEE)
	  driver.

config MITEE_SHM_NUM_PRIV_PAGES
	int "Private Shared Memory Pages"
	default 1
	depends on MITEE
	help
	  This sets the number of private shared memory pages to be
	  used by OP-TEE TEE driver.

config MITEE_BENCHMARK
	bool "OP-TEE Benchmark (EXPERIMENTAL)"
	depends on MITEE
	help
	  This enables benchmarking feature in the OP-TEE Trusted
	  Execution Environment (TEE) driver.
```
